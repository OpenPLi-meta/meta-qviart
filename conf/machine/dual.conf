## conf/machine/dual.conf
```bitbake
#@TYPE: Machine
#@NAME: dual
#@DESCRIPTION: Machine configuration for the dual

SOC_FAMILY = "hisi3798mv200"
CHIPSET = "Hi3798Mv200"
HICHIPSET = "3798mv200"

BRAND_OEM = "dags"
MACHINE_BRAND = "qviart"
MACHINE_NAME = "DUAL 4K UHD"
MACHINE_MODEL = "dagsmv200"

FRIENDLY_FAMILY = "dagsmv200"
STB_PLATFORM = "dagsmv200"

MTD_KERNEL = "mmcblk0p27"
MTD_ROOTFS = "mmcblk0p30"
KERNEL_FILE = "kernel.bin"
ROOTFS_FILE = "rootfs.tar.bz2"
MTD_BLACK  = "mmcblk0"

MACHINE_FEATURES += "blindscan-dvbs dvb-c hisil mali no-subssupport HDMI AV_JACK fastboot emmc fastboot 7segment skins1080"
OPENPLI_FEATURES += " qtplugins kodi openhbbtvbrowser"
DISTRO_FEATURES_remove = "x11 wayland directfb"

EXTRA_OECONF_append_pn-enigma2 = "--with-lcddev=/dev/null --with-alphablendingacceleration=always --with-blitaccelerationthreshold=250  --with-fillaccelerationthreshold=190000"

require conf/machine/include/qviart-hisi.inc

KV = "linux-4.4.35"

PREFERRED_VERSION_linux-qviart = "4.4.35"
```

## conf/machine/lunix.conf
```bitbake
#@TYPE: Machine
#@NAME: qviart
#@DESCRIPTION: Machine configuration for the qviart lunix

SOC_FAMILY = "bcm73625"
CHIPSET = "bcm73625"

BRAND_OEM = "dags"
MACHINE_BRAND = "qviart"
MACHINE_NAME = "LUNIX"

FRIENDLY_FAMILY = "dags73625"
STB_PLATFORM = "dags73625"
MACHINE_MODEL = "dags73625"

KERNEL_FILE = "oe_kernel.bin"
ROOTFS_FILE = "oe_rootfs.bin"
MTD_KERNEL = "mtd2"
MTD_ROOTFS = "mtd0"

MACHINE_FEATURES += " HDMI ci textlcd blindscan-dvbs skins1080"

IMAGEDIR ?= "update/lunix/cfe"

require conf/machine/include/qviart.inc
```

## conf/machine/lunix3-4k.conf
```bitbake
#@TYPE: Machine
#@NAME: qviart Lunix3-4k galaxy4k
#@DESCRIPTION: Machine configuration for the Lunix3-4k.

SOC_FAMILY = "bcm7439"
CHIPSET = "bcm7439"

BRAND_OEM = "dags"
MACHINE_BRAND = "qviart"
MACHINE_NAME = "LUNIX3 4K"

KERNEL_FILE = "oe_kernel.bin"
ROOTFS_FILE = "rootfs.tar.bz2"
MTD_BLACK = "mmcblk0"
MTD_KERNEL = "mmcblk0p1"
MTD_ROOTFS = "mmcblk0p4"

MACHINE_FEATURES += " HDMI RCA textlcd dvbproxy dvb-c transcoding streamproxy skins1080"

UPDATE_DIR = "lunix3-4k"

require conf/machine/include/qviart4k.inc

KV = "linux-3.14-28"
PREFERRED_VERSION_linux-qviart = "3.14.28"

FORCE_REBOOT_OPTION = "reboot"

MACHINE_KERNEL_PR = "r1"

IMAGE_FSTYPES =+ "ext4"

MODEL_SIZE = "300mm"

MACHINE_ESSENTIAL_EXTRA_RDEPENDS += " \
	qviart-dvb-modules-${MACHINE} \
"
```

## conf/machine/lunix4k.conf
```bitbake
#@TYPE: Machine
#@NAME: qviart lunix 4k (72604)
#@DESCRIPTION: Machine configuration for the lunix 4k.

SOC_FAMILY = "bcm72604"
CHIPSET = "bcm72604"

BRAND_OEM = "dags"
MACHINE_BRAND = "qviart"
MACHINE_NAME = "LUNIX 4K"

FRIENDLY_FAMILY = "dags72604"
STB_PLATFORM = "dags72604"
MACHINE_MODEL = "dags72604"

KERNEL_FILE = "oe_kernel.bin"
ROOTFS_FILE = "oe_rootfs.bin"
MTD_KERNEL = "mmcblk0p1"
MTD_ROOTFS = "mmcblk0p4"

MACHINE_FEATURES += " HDMI ci textlcd emmc blindscan-dvbs proxy dvb-c v3d-cortexa15 swap textlcd skins1080"
OPENPLI_FEATURES += " qtplugins kodi openhbbtvbrowser"

UPDATE_DIR = "lunix4k"

require conf/machine/include/qviart4k.inc

KV = "linux-4.1.20"

FORCE_REBOOT_OPTION = "reboot"

MACHINE_KERNEL_PR = "r1"

IMAGE_FSTYPES =+ "ext4"

PREFERRED_VERSION_linux-qviart = "4.1.20"

CHIP = "72604"

PREFERRED_PROVIDER_virtual/egl = "v3d-libgles-${CHIP}" 
PREFERRED_PROVIDER_virtual/libgles2 = "v3d-libgles-${CHIP}"
PREFERRED_PROVIDER_virtual/blindscan-dvbs = "qviart-blindscan-utils-${CHIP}"

MACHINE_ESSENTIAL_EXTRA_RDEPENDS += " \
	${@bb.utils.contains("MACHINE_FEATURES", "proxy", "platform-util-${CHIP} qviart-dvb-modules-${MACHINE}", "", d)} \
	${@bb.utils.contains("MACHINE_FEATURES", "v3d-cortexa15", "v3d-libgles-${CHIP}","", d)} \
	${@bb.utils.contains("MACHINE_FEATURES", "swap", "swapcreate-${CHIP}", "", d)} \
	${@bb.utils.contains("MACHINE_FEATURES", "blindscan-dvbs", "qviart-blindscan-utils-${CHIP}", "", d)} \
"

BBMASK = "meta-vuplus/recipes-graphics/"
BBMASK += "meta-vuplus/recipes-webkit/"
```
